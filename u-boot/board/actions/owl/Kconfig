## u-boot/board/actions/owl/Kconfig
```kconfig
if TARGET_ATM7059
config SYS_BOARD
	default "owl"

config SYS_VENDOR
	default "actions"

config SYS_SOC
	default "owl"

config SYS_CONFIG_NAME
	default "atm7059"

endif
if TARGET_S500
config SYS_BOARD
	default "owl"

config SYS_VENDOR
	default "actions"

config SYS_SOC
	default "owl"

config SYS_CONFIG_NAME
	default "s500"

endif

if TARGET_S500_UPGRADE
config SYS_BOARD
	default "owl"

config SYS_VENDOR
	default "actions"

config SYS_SOC
	default "owl"

config SYS_CONFIG_NAME
	default "s500_upgrade"

endif
```

## u-boot/drivers/misc/misc-info/Kconfig
```kconfig
config MISC_INFO
	bool "Enable MISC INFO ACCESS Driver"
	help
	  The Misc info access driver save the hardware information like
	  serial no, wifi mac etc.
```
