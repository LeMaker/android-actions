## kernel/drivers/media/i2c/camera/sensor_detect/Kconfig
```kconfig
#
# Actions CPU si or isp driver and the camera sensors of Actions support 
#
# 

config SENSOR_DETECT
	tristate "sensor detect module"
	depends on VIDEO_V4L2 && I2C
	help
	  Detect functions of camera sensors that actions supports; 

	  To compile this driver as a module, choose M here: the
	  module will be called sensor_detect.
```

## kernel/drivers/media/i2c/camera/siv121du/Kconfig
```kconfig
#
# Actions CPU si or isp driver and the camera sensors of Actions support 
#
# 

config SIV121DU
	tristate "siv121du camera sensor driver"
	depends on VIDEO_V4L2 && I2C
	help
	  Support for siv121du camera

	  To compile this driver as a module, choose M here: the
	  module will be called siv121du.
```

## kernel/drivers/media/i2c/camera/soc5140/Kconfig
```kconfig
#
# Actions CPU si or isp driver and the camera sensors of Actions support 
#
# 

config SOC5140
	tristate "soc5140 camera sensor driver"
	depends on VIDEO_V4L2 && I2C
	help
	  Support for soc5140 camera

	  To compile this driver as a module, choose M here: the
	  module will be called soc5140.
```

## kernel/drivers/media/i2c/camera/sp0718/Kconfig
```kconfig
#
# Actions CPU si or isp driver and the camera sensors of Actions support 
#
# 

config SP0718
	tristate "sp0718 camera sensor driver"
	depends on VIDEO_V4L2 && I2C
	help
	  Support for sp0718 camera

	  To compile this driver as a module, choose M here: the
	  module will be called sp0718.
```

## kernel/drivers/media/i2c/camera/sp0a19/Kconfig
```kconfig
#
# Actions CPU si or isp driver and the camera sensors of Actions support 
#
# 

config SP0A19
	tristate "sp0a19 camera sensor driver"
	depends on VIDEO_V4L2 && I2C
	help
	  Support for sp0a19 camera

	  To compile this driver as a module, choose M here: the
	  module will be called sp0a19.
```

## kernel/drivers/media/i2c/camera/sp2519/Kconfig
```kconfig
#
# Actions CPU si or isp driver and the camera sensors of Actions support 
#
# 

config SP2519
	tristate "sp2519 camera sensor driver"
	depends on VIDEO_V4L2 && I2C
	help
	  Support for sp2519 camera

	  To compile this driver as a module, choose M here: the
	  module will be called sp2519.
```

## kernel/drivers/misc/misc-info/Kconfig
```kconfig
#
# ACTIONS's MISC INFO ACCESS driver for save important data like serial num,
# wifi mac etc.
#
menu "ACTIONS MISC INFO ACCESS DRIVER"
config MISC_INFO
	tristate "Misc info access driver"
	default y
	help
	  The Misc info access driver save the hardware information like
	  serial no, wifi mac etc.
	  Each function can be configured and enabled/disabled
	  dynamically from userspace through a debugfs interface.

	  If unsure, say "y".
endmenu
```

## kernel/drivers/net/ethernet/acts/Kconfig
```kconfig
config NET_VENDOR_ACTS
	tristate "Actions Ethernet driver"
	default m
	---help---
		enable Actions Semi 520X ethernet driver
config POLL_PHY_STATE
	tristate "Phy state check"
	default n
	---help---
		poll the phy's sate
config PHY_RTL8201_SR8201G
	tristate "phy type"
	default n
	---help---
		compatible with realtek rtl8201 and corechip sr8201g
```

## kernel/drivers/net/ethernet/sg8201g/Kconfig
```kconfig
config NET_VENDOR_SG8201G
	tristate "Actions Ethernet driver(SG8021G)"
	default n
	---help---
		enable Actions Semi 520X ethernet driver
```

## kernel/drivers/net/wireless/actions/Kconfig
```kconfig
config BROADCOM_WIFI_BT
	tristate "Broadcom 4329/30 wireless cards support"
	---help---
	  This module adds support for wireless adapters based on
	  Broadcom 4329/30 chipset.

config RTL8723BS
	tristate "Realtek rtl8723bs wireless modules cards support"
	---help---
	  This module adds support for wireless adapters based on
	  sdio.
	  
config RTL8723BS_VQ0
	tristate "Realtek rtl8723bs-vq0 wireless modules cards support"
	---help---
	  This module adds support for wireless adapters based on
	  sdio.
	  
config RTL8723BU
	tristate "Realtek rtl8723bu wireless modules cards support"
	---help---
	  This module adds support for wireless adapters based on
	  usb.

source "drivers/net/wireless/actions/rtl8188etv/Kconfig"
```

## kernel/drivers/net/wireless/actions/rtl8188etv/Kconfig
```kconfig
config RTL8188ETV
	tristate "Realtek rtl8188etv/eus USB WiFi"
	depends on USB
	---help---
	  Help message of rtl8188etv/eus
```

## kernel/drivers/usb/aotg/Kconfig
```kconfig
#
# Actions usb2.0 controllers configuration
#

config USB_AOTG
	tristate "Actions usb2.0 otg support"
	default y
	---help---
	  The Actions chips have USB2.0 otg controllers. Enable
	  this option if your board uses this chip. If unsure, say N.

	  To compile this driver as a module, choose M here: the
	  module will be called acts_usb.
```

## kernel/drivers/usb/monitor/Kconfig
```kconfig
#
# USB Monitor configuration
#

config USB_ACTIONS_MON
	tristate "USB Actions Monitor"
	depends on ARCH_OWL
	help
	  If you select this option, a component which captures the USB traffic
	  between peripheral-specific drivers and HC drivers will be built.
	  For more information, see <file:Documentation/usb/usbmon.txt>.

	  If unsure, say Y, if allowed, otherwise M.

config USB_PLATFORM_LINUX
	tristate "USB Monitor For Linux"
	depends on ARCH_OWL && USB_ACTIONS_MON
	help
	  If you select this option usb monitor just detect usb plug in/out ,sent uevent & open
	  or close usb controller.
	  if not , usb monitor will support android system by sent uevent to vold;

	  If unsure, say Y, if allowed, otherwise M.	  
```

## kernel/drivers/video/owl/Kconfig
```kconfig
menuconfig VIDEO_OWL
	bool "OWL video support"
	depends on ARCH_OWL
        help
	  Actions OWL Soc video support.

if VIDEO_OWL
source "drivers/video/owl/vce/Kconfig"
source "drivers/video/owl/vde/Kconfig"
source "drivers/video/owl/backlight/Kconfig"
source "drivers/video/owl/dss/Kconfig"
source "drivers/video/owl/displays/Kconfig"
source "drivers/video/owl/fb/Kconfig"

endif
```

## kernel/drivers/video/owl/backlight/Kconfig
```kconfig
config VIDEO_OWL_PWM_BACKLIGHT
	tristate "OWL PWM backlight support"
	---help---
	  Actions OWL Soc PWM backlight support.

	  Say Y here if you need pwm backligh in your system.

	  To compile this driver as a module, choose M here: the
	  module will be called owl_pwm_bl.ko.
```

## kernel/drivers/video/owl/displays/Kconfig
```kconfig
source "drivers/video/owl/displays/lcdc/Kconfig"
source "drivers/video/owl/displays/dsi/Kconfig"
source "drivers/video/owl/displays/hdmi/Kconfig"
source "drivers/video/owl/displays/cvbs/Kconfig"
#source "drivers/video/owl/displays/edp/Kconfig"
```

## kernel/drivers/video/owl/displays/cvbs/Kconfig
```kconfig
config VIDEO_OWL_CVBS
	tristate "OWL cvbs support"
	depends on ARCH_OWL
	---help---
	  Say Y here if you need cvbs controller in your system.

	  If unsure, say Y.

	  To compile this driver as a module, choose M here.
```

## kernel/drivers/video/owl/displays/dsi/Kconfig
```kconfig
config VIDEO_OWL_DSI
	tristate "OWL dsi support"
	depends on ARCH_OWL
	---help---
	  Say Y here if you need dsi controller in your system.

	  If unsure, say Y.

	  To compile this driver as a module, choose M here.
```

## kernel/drivers/video/owl/displays/hdmi/Kconfig
```kconfig
config VIDEO_OWL_NO_DVI
	bool "video no dvi"

config VIDEO_OWL_HDMI
	tristate "OWL hdmi support"
	---help---
	  Actions OWL Soc hdmi controller support.

	  Say Y here if you need it in your system.
	  If unsure, say Y.

	  To compile this driver as a module, choose M here.
```

## kernel/drivers/video/owl/displays/lcdc/Kconfig
```kconfig
config VIDEO_OWL_LCDC
	tristate "OWL lcd controller support"
	---help---
	  Actions OWL Soc lcd controller support.

	  Say Y here if you need it in your system.
	  If unsure, say Y.

	  To compile this driver as a module, choose M here.
```

## kernel/drivers/video/owl/dss/Kconfig
```kconfig
config VIDEO_OWL_DSS
	tristate "OWL Display Subsystem support"
	---help---
	  Actions OWL Soc Display Subsystem support.

	  Say Y here if you need it in your system.
	  If unsure, say Y.

	  To compile this driver as a module, choose M here.

config VIDEO_OWL_DE_ATM7059
	bool "ATM7059 Display Engine"
	depends on VIDEO_OWL_DSS
	---help---
	  Say Y here if you need support ATM7059 DE.

	  If unsure, say Y.

config VIDEO_OWL_DE_ATM9009
	bool "ATM9009 Display Engine"
	depends on VIDEO_OWL_DSS
	---help---
	  Say Y here if you need support ATM9009 DE.

	  If unsure, say Y.

config VIDEO_OWL_MMU_SUPPORT
	bool "OWL DE MMU Support"
	depends on VIDEO_OWL_DE_ATM9009 || VIDEO_OWL_DE_ATM7059
	---help---
	  Actions OWL Soc Display Engine MMU support.

	  Say Y here if you need MMU function.

	  If unsure, say Y.

config VIDEO_OWL_MMU_ION_SUPPORT
	bool "OWL DE MMU ION Support"
	depends on VIDEO_OWL_MMU_SUPPORT
	---help---
	  Actions OWL Soc Display Engine MMU ION support

	  Say Y here if you need MMU ION function.

	  If unsure, say Y.
```

## kernel/drivers/video/owl/fb/Kconfig
```kconfig
config FB_COLOR_MODE_XRGB32
	bool "use xrgb32 color mode, default is xbgr32"

config FB_MAP_TO_DE
	bool "map fb to de"
	
config FB_DEFAULT_MIRROR_TO_HDMI
	bool "mirror fb to hdmi as default"

config VIDEO_OWL_FB
	tristate "OWL framebuffer support"
	select FB_CFB_FILLRECT
	select FB_CFB_COPYAREA
	select FB_CFB_IMAGEBLIT
	---help---
	  Actions OWL Soc framebuffer support.

	  Say Y here if you need it in your system.
	  If unsure, say Y.

	  To compile this driver as a module, choose M here.
```

## kernel/drivers/video/owl/vce/Kconfig
```kconfig
config VIDEO_ACTIONS_VCE
	tristate "Asoc Video encoder support"
	depends on ARCH_OWL
	---help---
	  Say Y here if you need video recoder support to your system.

	  If unsure, say N.

	  To compile this driver as a module, choose M here: the
	  module will be called vce_drv.ko.
```

## kernel/drivers/video/owl/vde/Kconfig
```kconfig
config VIDEO_ACTIONS_VDE
	tristate "Asoc Video decoder support"
	depends on ARCH_OWL
	---help---
	  Say Y here if you need video decoder support to your system.

	  If unsure, say N.

	  To compile this driver as a module, choose M here: the
	  module will be called vde_drv.ko.
```

## kernel/sound/soc/atc260x/Kconfig
```kconfig
config SND_SOC_OWL
	tristate
	depends on SND_SOC

config SND_SOC_ATC2603A 
	tristate
	depends on SND_SOC_OWL

config SND_SOC_ATC2603C 
	tristate
	depends on SND_SOC_OWL	

config SND_SOC_HDMI_OWL
	tristate
	depends on SND_SOC_OWL

config SND_SOC_DAI_OWL
	tristate
	depends on SND_SOC_OWL

config SND_SOC_ALL_PMU_OWL
	tristate "SoC Audio support for all pmus owl board"
	select SND_SOC_OWL
	select SND_SOC_HDMI_OWL
	select SND_SOC_DAI_OWL
	select SND_SOC_ATC2603A
	select SND_SOC_ATC2603C
	help
	  Say Y if you want to add support for SoC audio on atc2603a-based
	  ATM7059 board.	  
```
