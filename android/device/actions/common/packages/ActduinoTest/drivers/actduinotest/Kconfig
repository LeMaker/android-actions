## android/device/actions/common/packages/ActduinoTest/drivers/actduinotest/Kconfig
```kconfig
#
# ActduinoTest configuration
#
menu "ActduinoTest support"

source "drivers/actduinotest/i2c_test/Kconfig"
source "drivers/actduinotest/spi_test/Kconfig"
source "drivers/actduinotest/gpio_test/Kconfig"
source "drivers/actduinotest/adc_test/Kconfig"
source "drivers/actduinotest/pwm_test/Kconfig

endmenu
```

## android/device/actions/common/packages/ActduinoTest/drivers/actduinotest/adc_test/Kconfig
```kconfig
config ADC_OWL_TEST
        tristate "ActduinoTest:ADC OWL Test"
        depends on y
        help
          This is ActduinoTest adc testcase driver
```

## android/device/actions/common/packages/ActduinoTest/drivers/actduinotest/gpio_test/Kconfig
```kconfig
config GPIO_OWL_TEST
        tristate "ActduinoTest:GPIO OWL Test"
        depends on y
        help
          This is ActduinoTest gpio testcase driver
```

## android/device/actions/common/packages/ActduinoTest/drivers/actduinotest/i2c_test/Kconfig
```kconfig
config I2C_OWL_TEST
        tristate "ActduinoTest:I2C OWL Test"
        depends on y
        help
          This is ActduinoTest i2c testcase driver
```

## android/device/actions/common/packages/ActduinoTest/drivers/actduinotest/pwm_test/Kconfig
```kconfig
config PWM_OWL_TEST
        tristate "ActduinoTest:PWM OWL Test"
        depends on y
        help
          This is ActduinoTest pwm testcase driver
```

## android/device/actions/common/packages/ActduinoTest/drivers/actduinotest/spi_test/Kconfig
```kconfig
config SPI_OWL_TEST
        tristate "ActduinoTest:SPI OWL Test"
        depends on y
        help
          This is ActduinoTest spi testcase driver
```

## kernel/Documentation/devicetree/bindings/arm/actions.txt
```
Actions Arm-platform device tree bindings
-------------------------------------------
Boards with the s500 SoC shall have the following properties:

Required root node property:

compatible = "actions,s500", "actions,owl", "actions,atm7059a";
```

## kernel/Documentation/devicetree/bindings/gpio/gpio_actions.txt
```
Actions SOC GPIO controller

Required properties:
- compatible : "actions,gl<chip-no>-gpio"
- reg : Physical base address and length of the controller's registers.
- interrupts : The interrupt outputs from the controller. For GL5203,
  there should be 8 interrupts specified, 3 SIRQ & 5 GPIO interrupts.
- #gpio-cells : Should be two. The first cell is the pin number and the
  second cell is used to specify optional parameters:
  - bit 0 specifies polarity (0 for normal, 1 for inverted)
- gpio-controller : Marks the device node as a GPIO controller.
- #interrupt-cells : Should be 2.
  The first cell is the GPIO number, for GPIO<s><n>, N = (s - 'A') * 32 + n,
  for GPIOB2, GPIO number is 34.
  The second cell is used to specify flags:
    bits[3:0] trigger type and level flags:
      1 = low-to-high edge triggered.
      2 = high-to-low edge triggered.
      4 = active high level-sensitive.
      8 = active low level-sensitive.
      Valid combinations are 1, 2, 3, 4, 8.
- interrupt-controller : Marks the device node as an interrupt controller.

Example:

gpio: gpio@b01b0000 {
	compatible = "actions,atm7059a-gpio";
	reg = < 0xb01b0000 0x40 >;
	interrupts = <
		0 36 0x04 /* GPIOA */
		0 37 0x04 /* GPIOB */
		0 38 0x04 /* GPIOC */
		0 39 0x04 /* GPIOD */
		0 40 0x04 /* GPIOE */ >;
	#gpio-cells = <2>;
	gpio-controller;
	#interrupt-cells = <2>;
	interrupt-controller;
};
```

## kernel/Kconfig
```kconfig
#
# For a description of the syntax of this configuration file,
# see Documentation/kbuild/kconfig-language.txt.
#
mainmenu "Linux/$ARCH $KERNELVERSION Kernel Configuration"

config SRCARCH
	string
	option env="SRCARCH"

source "arch/$SRCARCH/Kconfig"
config PLATFORM_UBUNTU
	tristate "ubuntu: wifi uses only one interface, bt uses bluez"
```

## kernel/arch/arm/mach-owl/Kconfig
```kconfig
comment "Owl configurations"
	depends on ARCH_OWL

choice
	prompt "Owl Board Type"
	depends on ARCH_OWL
	default MACH_OWL

config MACH_OWL
	boolean "Actions owl board"
	depends on ARCH_OWL
	select ARCH_HAS_CPUFREQ
	select ARCH_REQUIRE_GPIOLIB
	select PINCTRL
	select USE_OF
	select NEON
	select VFP
	select ARM_GIC
	select CPU_V7
	select HAVE_ARM_SCU if SMP
	select HAVE_ARM_TWD if LOCAL_TIMERS
	select HAVE_SMP
	select VIRT_TO_BUS
	select OWL_CLOSE_PATCH
        help
          board configuration for actions gs703a fpga, evb, etc.

endchoice

config OWL_DEBUG_IRQ_STACK
	boolean "Enable Actions irq stack debugger"
	depends on ARCH_OWL
	help
	  Enable Actions irq stack debugger, say Y.  Otherwise, say N.
	  
config SERIAL_OWL
	boolean "Enable Actions SoCs' UART Support"
	depends on ARCH_OWL
	select SERIAL_CORE
	help
	  If you have a ARM-based Actions SoC
	  and you want to use serial ports, say Y.  Otherwise, say N.

config SERIAL_OWL_CONSOLE
	boolean "Enable Actions SoCs serial console"
	depends on SERIAL_OWL
	select SERIAL_CORE_CONSOLE
	help
	  If you have a ARM-based  Actions SoC
	  and you want to use serial console, say Y. Otherwise, say N.

config CONFIG_HOTPLUG_OWL
	boolean "Enable cpu auto hotplug according to cpu loading"
	depends on ARCH_OWL && CONFIG_HOTPLUG_CPU && CONFIG_ARM_OWL_CPUFREQ
	help
	  If you want to enable cpu auto hotplug according to cpu loading, 
	  say Y. Otherwise, say N.
	  
config OWL_CONSOLE_KEEP_ON
	boolean "Keep on Actions SoCs serial console"
	depends on SERIAL_OWL_CONSOLE
	help
	  If you want to get more print from
	  serial console for debug, say Y. Otherwise, say N.

config GPIO_OWL
	boolean "Enable Actions SoCs GPIO"
	depends on GPIOLIB
	help
	  If you have a ARM-based  Actions SoC
	  and you want to use GPIO, say Y. Otherwise, say N.

config GPU_RESERVED_SIZE
    int "Reserved memory for GPU (Mbytes)"
	default "64"
	depends on ARCH_OWL
	help
	  The default reserver value is 32M RAM. Change this if you know what you
	  are doing.

config ION_RESERVED_SIZE
    int "Reserved memory for ION (Mbytes)"
	default "64"
	depends on ION || ION_OWL
	help
	  The default reserver value is 64M RAM. Change this if you know what you
	  are doing.

config FB_RESERVED_SIZE
    int "Reserved memory for Framebuffer (Mbytes)"
	default "32"
	depends on ARCH_OWL
	help
	  The default reserver value is 32M RAM. Change this if you know what you
	  are doing.

config I2C_OWL
	tristate "Actions Actions SOC I2C"
	depends on ARCH_OWL
	help
	  Enable the use of the I2C bus controllers on the Actions SOC Verify
	  If you don't know what to do here, say N.

config I2C_OWL_BUS0
	tristate "Actions SOC I2C0"
	depends on I2C_OWL
	help
	  Enable the use of the I2C bus 0 controllers on the Actions SOC Verify
	  If you don't know what to do here, say N.

config I2C_OWL_BUS1
	tristate "Actions SOC I2C1"
	depends on I2C_OWL
	help
	  Enable the use of the I2C bus 1 controllers on the Actions SOC Verify
	  If you don't know what to do here, say N.

config I2C_OWL_BUS2
	tristate "Actions SOC I2C2"
	depends on I2C_OWL
	help
	  Enable the use of the I2C bus 2 controllers on the Actions SOC Verify
	  If you don't know what to do here, say N.

config I2C_OWL_BUS3
        tristate "Actions SOC I2C3"
        depends on I2C_OWL
        help
          Enable the use of the I2C bus 3 controllers on the Actions SOC Verify
          If you don't know what to do here, say N.

config PINCTRL_OWL
	bool "Actions SOC pin controller driver"
	depends on ARCH_OWL
	select PINCTRL
	select PINMUX
	select PINCONF
	help
	  Pin controller driver for Actions SOC

config ACTIONS_SOC_CAMERA
	tristate "SoC camera support"
	depends on VIDEO_V4L2 && HAS_DMA && I2C
	select VIDEOBUF_GEN
	select VIDEOBUF2_CORE
	select VIDEOBUF_DMA_CONTIG
	select VIDEOBUF2_DMA_CONTIG
	help
	  SoC Camera is a common API to several cameras, not connecting
	  over a bus like PCI or USB. For example some i2c camera connected
	  directly to the data bus of an SoC.

config FB_ACTIONS
	tristate "Actions framebuffer support"
	depends on FB
	select FB_CFB_FILLRECT
	select FB_CFB_COPYAREA
	select FB_CFB_IMAGEBLIT
	---help---
	This enables support for the ACTIONS framebuffer in the kernel .

config BACKLIGHT_ACTIONS
	tristate "Actions backlight"
	select BACKLIGHT_CLASS_DEVICE
	select ACT_BACKLIGHT
  ---help---
	This enables support for the ACTIONS backlight in the kernel .

config CPUFREQ_ACTIONS
	bool "Actions cpufreq"
	select CPU_FREQ
	select CPU_FREQ_TABLE
  help
    This enables support for the ACTIONS cpufreq driver. Selecting
    this will NOT enable coresponding Actions driver. It just helps
    to select the necessary kernel configs for the out-kernel drivers.

config OWL_CLOSE_PATCH
	bool
```

## kernel/drivers/input/lightsensor/Kconfig
```kconfig
#
# Input misc drivers configuration
#
menuconfig INPUT_LIGHT_GSENSOR
	bool "Light sensor devices"
	help
	  Say Y here, and a list of miscellaneous input drivers will be displayed.
	  Everything that didn't fit into the other categories is here. This option
	  doesn't affect the kernel.

	  If unsure, say Y.

if INPUT_LIGHT_GSENSOR

config LIGHT_GSENSOR_LTR301
	tristate "lightsensor ltr301 support"
	depends on I2C
	help
	  Support the lightsensor ltr301 as an input device

	  To compile this driver as a module, choose M here: the module
	  will be called ltr301.

endif
```

## kernel/drivers/input/magsensor/Kconfig
```kconfig
#
# Input misc drivers configuration
#
menuconfig INPUT_MAGSENSOR
	bool "Magsensor devices"
	help
	  Say Y here, and a list of miscellaneous input drivers will be displayed.
	  Everything that didn't fit into the other categories is here. This option
	  doesn't affect the kernel.

	  If unsure, say Y.

if INPUT_MAGSENSOR

config MAGSENSOR_MC6420
	tristate "magsensor mc6420 support"
	depends on I2C
	help
	  Support the magsensor mc6420 as an input device

	  To compile this driver as a module, choose M here: the module
	  will be called mc6420.

endif
```

## kernel/drivers/input/misc/gsensor/Kconfig
```kconfig
#
# Input misc drivers configuration
#
menuconfig INPUT_GSENSOR
	bool "Actions Gsensor devices"
	help
	  Say Y here, and a list of miscellaneous input drivers will be displayed.
	  Everything that didn't fit into the other categories is here. This option
	  doesn't affect the kernel.

	  If unsure, say Y.

if INPUT_GSENSOR

config GSENSOR_DETECT
	tristate "gsensor_detect support"
	depends on I2C
	help
	  Support the gsensor auto detect as an input device
	  detect the gsesnor automatically.

	  To compile this driver as a module, choose M here: the module
	  will be called gsensor_detect.

config GSENSOR_BMA222
	tristate "bma222 support"
	depends on I2C
	help
	  Support the bma222 as an input device

	  To compile this driver as a module, choose M here: the module
	  will be called bma222.
	  
config GSENSOR_STK8312
	tristate "stk8312 support"
	depends on I2C
	help
	  Support the stk8312 as an input device

	  To compile this driver as a module, choose M here: the module
	  will be called stk8312.
	  
config GSENSOR_STK8313
	tristate "stk8313 support"
	depends on I2C
	help
	  Support the stk8313 as an input device

	  To compile this driver as a module, choose M here: the module
	  will be called stk8313.
	  
config GSENSOR_MC3236
	tristate "mc3236 support"
	depends on I2C
	help
	  Support the mc3236 as an input device

	  To compile this driver as a module, choose M here: the module
	  will be called bma250_dummy.
	  
config GSENSOR_MC3230
	tristate "mc3230 support"
	depends on I2C
	help
	  Support the mc3230 as an input device

	  To compile this driver as a module, choose M here: the module
	  will be called bma250_dummy.
	  
config GSENSOR_MC3232
	tristate "mc3232 support"
	depends on I2C
	help
	  Support the mc3232 as an input device

	  To compile this driver as a module, choose M here: the module
	  will be called mc3232.
	  
config GSENSOR_MMA7660
	tristate "mma7660 support"
	depends on I2C
	help
	  Support the mma7660 as an input device

	  To compile this driver as a module, choose M here: the module
	  will be called mma7660.
	  
config GSENSOR_KIONIX
       tristate "kionix support"
       depends on I2C
       help
         Support the kionix as an input device

         To compile this driver as a module, choose M here: the module
         will be called kionix.

config GSENSOR_MIR3DA
	tristate "mir3da support"
	depends on I2C
	help
	  Support the mir3da as an input device

	  To compile this driver as a module, choose M here: the module
	  will be called mir3da.
endif
```

## kernel/drivers/media/i2c/camera/Kconfig
```kconfig
#
# Actions CPU si or isp driver and the camera sensors of Actions support 
#
# 

source "drivers/media/i2c/camera/gc2035/Kconfig"
source "drivers/media/i2c/camera/gc0308/Kconfig"
source "drivers/media/i2c/camera/gc2155/Kconfig"
source "drivers/media/i2c/camera/gc0312/Kconfig"
source "drivers/media/i2c/camera/gc2145/Kconfig"
source "drivers/media/i2c/camera/gc0328/Kconfig"
source "drivers/media/i2c/camera/gc0329/Kconfig"
source "drivers/media/i2c/camera/sp0a19/Kconfig"
source "drivers/media/i2c/camera/hi257/Kconfig"
source "drivers/media/i2c/camera/hi708/Kconfig"
source "drivers/media/i2c/camera/ov5640/Kconfig"
source "drivers/media/i2c/camera/sp2519/Kconfig"
source "drivers/media/i2c/camera/ov2686/Kconfig"
source "drivers/media/i2c/camera/soc5140/Kconfig"
source "drivers/media/i2c/camera/sp0718/Kconfig"
source "drivers/media/i2c/camera/siv121du/Kconfig"
source "drivers/media/i2c/camera/flashlight/Kconfig"
source "drivers/media/i2c/camera/owl_camera/Kconfig"
source "drivers/media/i2c/camera/sensor_detect/Kconfig"
```

## kernel/drivers/media/i2c/camera/gc0308/Kconfig
```kconfig
#
# Actions CPU si or isp driver and the camera sensors of Actions support 
#
# 

config GC0308
	tristate "gc0308 camera sensor driver"
	depends on VIDEO_V4L2 && I2C
	help
	  Support for gc0308 camera

	  To compile this driver as a module, choose M here: the
	  module will be called gc0308.
```

## kernel/drivers/media/i2c/camera/gc0328/Kconfig
```kconfig
#
# Actions CPU si or isp driver and the camera sensors of Actions support 
#
# 

config GC0328
	tristate "gc0328 camera sensor driver"
	depends on VIDEO_V4L2 && I2C
	help
	  Support for gc0328 camera

	  To compile this driver as a module, choose M here: the
	  module will be called gc0328.
```

## kernel/drivers/media/i2c/camera/gc0329/Kconfig
```kconfig
#
# Actions CPU si or isp driver and the camera sensors of Actions support 
#
# 

config GC0329
	tristate "gc0329 camera sensor driver"
	depends on VIDEO_V4L2 && I2C
	help
	  Support for gc0329 camera

	  To compile this driver as a module, choose M here: the
	  module will be called gc0329.
```

## kernel/drivers/media/i2c/camera/gc2145/Kconfig
```kconfig
#
# Actions CPU si or isp driver and the camera sensors of Actions support 
#
# 

config GC2145
	tristate "gc2145 camera sensor driver"
	depends on VIDEO_V4L2 && I2C
	help
	  Support for gc2145 camera

	  To compile this driver as a module, choose M here: the
	  module will be called gc2145.
```

## kernel/drivers/media/i2c/camera/gc2155/Kconfig
```kconfig
#
# Actions CPU si or isp driver and the camera sensors of Actions support 
#
# 

config GC2155
	tristate "gc2155 camera sensor driver"
	depends on VIDEO_V4L2 && I2C
	help
	  Support for gc2155 camera

	  To compile this driver as a module, choose M here: the
	  module will be called gc2155.
```

## kernel/drivers/media/i2c/camera/gs5604/Kconfig
```kconfig
#
# Actions CPU si or isp driver and the camera sensors of Actions support 
#
# 

config GS5604
	tristate "GS5604 camera sensor driver"
	depends on VIDEO_V4L2 && I2C
	help
	  Support for GS5604 camera

	  To compile this driver as a module, choose M here: the
	  module will be called GS5604.
```
