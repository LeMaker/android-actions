## kernel/drivers/media/i2c/camera/hi257/Kconfig
```kconfig
#
# Actions CPU si or isp driver and the camera sensors of Actions support 
#
# 

config HI257
	tristate "hi257 camera sensor driver"
	depends on VIDEO_V4L2 && I2C
	help
	  Support for hi257 camera

	  To compile this driver as a module, choose M here: the
	  module will be called hi257.
```

## kernel/drivers/media/i2c/camera/hi708/Kconfig
```kconfig
#
# Actions CPU si or isp driver and the camera sensors of Actions support 
#
# 

config HI708
	tristate "hi708 camera sensor driver"
	depends on VIDEO_V4L2 && I2C
	help
	  Support for hi708 camera

	  To compile this driver as a module, choose M here: the
	  module will be called hi708.
```

## kernel/drivers/media/i2c/camera/ov2686/Kconfig
```kconfig
#
# Actions CPU si or isp driver and the camera sensors of Actions support 
#
# 

config OV2686
	tristate "ov5640 camera sensor driver"
	depends on VIDEO_V4L2 && I2C
	help
	  Support for ov2686 camera

	  To compile this driver as a module, choose M here: the
	  module will be called ov2686.
```

## kernel/drivers/media/i2c/camera/ov5640/Kconfig
```kconfig
#
# Actions CPU si or isp driver and the camera sensors of Actions support 
#
# 

config OV5640
	tristate "ov5640 camera sensor driver"
	depends on VIDEO_V4L2 && I2C
	help
	  Support for ov5640 camera

	  To compile this driver as a module, choose M here: the
	  module will be called ov5640.
```

## kernel/drivers/media/i2c/camera/owl_camera/Kconfig
```kconfig
#
# Actions CPU si or isp driver and the camera sensors of Actions support 
#
# 

config OWL7059_CAMERA
	tristate "owl7059 si driver"
	depends on VIDEO_V4L2
	help
	  Support for owl7059 si

	  To compile this driver as a module, choose M here: the
	  module will be called owl7059_camera.
```
